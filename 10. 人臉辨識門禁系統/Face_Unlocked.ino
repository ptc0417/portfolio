#include "Wire.h"
#include "U8g2lib.h"
#include "HUSKYLENS.h"
#include <Wire.h>
#include "MFRC522_I2C.h"

#include <Tone32.h>

U8G2_SSD1306_128X64_NONAME_F_HW_I2C u8g2(U8G2_R0, /* reset=*/ U8X8_PIN_NONE);
HUSKYLENS huskylens;
int door = 0;

String card = "";

const unsigned char open[] U8X8_PROGMEM= {0x00, 0x00, 0x00, 0x00, 0x00, 0x00, 0x00, 0x00, 0x00, 0x00, 0x00, 0x00,    0x00,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 0x00, 0x00};

const unsigned char lock[] U8X8_PROGMEM= {0x00, 0x00, 0x00, 0x00, 0x00, 0x00, 0x00, 0x00, 0x00, 0x00, 0x00, 0x00,    0x00,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 0x00, 0x00};

const unsigned char n3[] U8X8_PROGMEM= {0x00, 0x00, 0x00, 0x00, 0x00, 0x00, 0x00, 0x00, 0x00, 0x00, 0x00, 0x00,    0x00,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 0x00, 0x00};

const unsigned char n2[] U8X8_PROGMEM= {0x00, 0x00, 0x00, 0x00, 0x00, 0x00, 0x00, 0x00, 0x00, 0x00, 0x00, 0x00,    0x00,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 0x00, 0x00};

const unsigned char n1[] U8X8_PROGMEM= {0x00, 0x00, 0x00, 0x00, 0x00, 0x00, 0x00, 0x00, 0x00, 0x00, 0x00, 0x00,    0x00,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 0x00, 0x00};

const unsigned char noperson[] U8X8_PROGMEM= {0x00, 0x00, 0x00, 0x00, 0x00, 0x00, 0x00, 0x00, 0x00, 0x00, 0x00, 0x00,    0x00,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 0x00, 0x00};

int readData[5] = {};
byte dataType = 0;
byte idCount = 0;
bool detection_now = 0;

MFRC522 mfrc522(0x28);

String readRFID() {
  String mfrc522ReadCode = "";
  if ( ! mfrc522.PICC_IsNewCardPresent() || ! mfrc522.PICC_ReadCardSerial() ) {}
  else {
    for (byte i = 0; i < mfrc522.uid.size; i++) {
      mfrc522ReadCode += String(mfrc522.uid.uidByte[i], HEX);
    }
  }
  return mfrc522ReadCode;
}

void chack_OK() {
  u8g2.clearBuffer();
  u8g2.drawXBMP(0, 0, 128, 64, open);
  u8g2.sendBuffer();
  door = 1;
  tone(27,494,0,0);
  delay(100);
  noTone(27,0);
}

void start_sound() {
  tone(27,262,0,0);
  delay(100);
  noTone(27,0);
  delay(500);
}

void chack_ERROR() {
  u8g2.clearBuffer();
  u8g2.drawXBMP(0, 0, 128, 64, noperson);
  u8g2.sendBuffer();
  for (int count = 0; count < 3; count++) {
    tone(27,262,0,0);
    delay(100);
    noTone(27,0);
    delay(100);
  }
  u8g2.clearBuffer();
  u8g2.drawXBMP(0, 0, 128, 64, lock);
  u8g2.sendBuffer();
}

void open_and_lock() {
  digitalWrite(26, HIGH);
  delay(1000);
  u8g2.clearBuffer();
  u8g2.drawXBMP(0, 0, 128, 64, n3);
  u8g2.sendBuffer();
  delay(1000);
  u8g2.clearBuffer();
  u8g2.drawXBMP(0, 0, 128, 64, n2);
  u8g2.sendBuffer();
  delay(1000);
  u8g2.clearBuffer();
  u8g2.drawXBMP(0, 0, 128, 64, n1);
  u8g2.sendBuffer();
  delay(1000);
  u8g2.clearBuffer();
  u8g2.drawXBMP(0, 0, 128, 64, lock);
  u8g2.sendBuffer();
  door = 0;
  start_sound();
  digitalWrite(26, LOW);
}

void setup()
{
  u8g2.begin();
  u8g2.setFont(u8g2_font_6x10_tf);
  u8g2.setFontRefHeightExtendedText();
  u8g2.setDrawColor(1);
  u8g2.setFontPosTop();
  u8g2.setFontDirection(0);

  Wire.begin();
  while (!huskylens.begin(Wire)) {
    Serial.println(F("Begin failed!"));
    Serial.println(F("1.Please recheck the \"Protocol Type\" in HUSKYLENS (General Settings>>Protocol Type>>I2C)"));
    Serial.println(F("2.Please recheck the connection."));
    delay(100);
  }

  u8g2.clearDisplay();
  huskylens.writeAlgorithm(ALGORITHM_FACE_RECOGNITION);
  u8g2.clearBuffer();
  u8g2.drawXBMP(0, 0, 128, 64, lock);
  u8g2.sendBuffer();
  pinMode(36, INPUT);
  Wire.begin();
  mfrc522.PCD_Init();

  tone(27,262,0,0);
  delay(1);
  noTone(27,0);

  pinMode(26, OUTPUT);
}


void loop()
{
  if (!huskylens.request()) {
    Serial.println(F("Fail to request data from HUSKYLENS, recheck the connection!"));
  }
  else {
    if (huskylens.available()) {
      detection_now = true;
      HUSKYLENSResult result = huskylens.read();
      idCount = huskylens.countLearned();
      if (result.command == COMMAND_RETURN_BLOCK){
        dataType = 0;
        readData[0] = result.xCenter;
        readData[1] = result.yCenter;
        readData[2] = result.width;
        readData[3] = result.height;
        readData[4] = result.ID;
      }
      else if (result.command == COMMAND_RETURN_ARROW){
        dataType = 1;
        readData[0] = result.xOrigin;
        readData[1] = result.yOrigin;
        readData[2] = result.xTarget;
        readData[3] = result.yTarget;
        readData[4] = result.ID;
      }
      else {
        for (byte i=0; i<5; i++) {
          readData[i] = 0;
        }
      }
    }
    else {
      detection_now = false;
    }
  }
  if (!digitalRead(36)) {
    start_sound();
    if (detection_now) {
      if (readData[4] == 1) {
        chack_OK();
      } else {
        chack_ERROR();
      }
    } else {
      chack_ERROR();
    }
  }
  card = readRFID();
  if (card != "") {
    start_sound();
    if (card == "a5b22b75") {
      chack_OK();
    } else {
      chack_ERROR();
    }
  }
  if (door == 1) {
    open_and_lock();
  }
  delay(100);
}
